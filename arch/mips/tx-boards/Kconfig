## arch/mips/tx-boards/Kconfig
```kconfig
config TX_RBTX4927
	bool "Support for TX RBTX4927"
	depends on TX_BOARDS
	select SYS_HAS_CPU_TX49XX
	select SYS_SUPPORTS_64BIT_KERNEL
	select HAS_TXX9_SERIAL

config TX_RBTX4938
	bool "Support for TX RBTX4938"
	depends on TX_BOARDS
	select SYS_HAS_CPU_TX49XX
	select SYS_SUPPORTS_64BIT_KERNEL
	select HAS_TXX9_SERIAL

config TX_RBTX4939
	bool "Support for TX RBTX4939"
	depends on TX_BOARDS
	select SYS_HAS_CPU_TX49XX
	select SYS_SUPPORTS_64BIT_KERNEL
	select HAS_TXX9_SERIAL

config TOSHIBA_TC90411
	bool "Support for Toshiba TC90411 Board"
	depends on TX_BOARDS
	select SYS_HAS_CPU_TX49XX
	select SYS_SUPPORTS_64BIT_KERNEL
	select HAS_TXX9_SERIAL
	select TOSHIBA_TSBLDADR

config TOSHIBA_TC90411_USBHC_WORKAROUND
	bool "Enable TC90411 USBHC Workaround"
	depends on TOSHIBA_TC90411

config TOSHIBA_OPBD4938
	bool "Support for Toshiba OPBD4938"
	depends on TX_BOARDS
	select SYS_HAS_CPU_TX49XX
	select SYS_SUPPORTS_64BIT_KERNEL
	select HAS_TXX9_SERIAL
	select TOSHIBA_TSBLDADR

config TOSHIBA_OPBD4939
	bool "Support for Toshiba OPBD4939"
	depends on TX_BOARDS
	select SYS_HAS_CPU_TX49XX
	select SYS_SUPPORTS_64BIT_KERNEL
	select HAS_TXX9_SERIAL
	select TOSHIBA_TSBLDADR

config TOSHIBA_TC90412
	bool "Support for Toshiba TC90412 Board"
	select SYS_HAS_CPU_TX49XX
	select SYS_SUPPORTS_64BIT_KERNEL
	select HAS_TXX9_SERIAL
	select TOSHIBA_TSBLDADR
	select TXBOARD_CPU_SCACHE

config TOSHIBA_TC90416
	bool "Support for Toshiba TC90416 Board"
	select SYS_HAS_CPU_MIPS32_R2
	select HAS_TXX9_SERIAL
	select TOSHIBA_TSBLDADR

config TOSHIBA_TC90490
	bool "Support for Toshiba TC90490 Chip"
	depends on TOSHIBA_TC90411 || TOSHIBA_TC90412

config TICK_BY_TXTMR0
	bool "Tick by TX subsystem TMR module Timer-0"
	depends on TOSHIBA_TC90416

config TOSHIBA_TSBLDADR
	bool

choice
	prompt "Optional load address settings"
	optional
	depends on TOSHIBA_TSBLDADR

config YAMON_BOOT
	bool "Use YAMON as bootloader (load address 0x80100000)"
	depends on TOSHIBA_TSBLDADR

config PMON_RAMBOOT
	bool "Use PMON booting from RAM"
	depends on TOSHIBA_TSBLDADR

endchoice

config PMON_RAMBOOT_LOADADDR
	hex "Kernel load address on PMON RAM boot"
	depends on PMON_RAMBOOT
	default 0xffffffff80200000

config PMON_RAMBOOT_PMONADDR
	hex "PMON base address on PMON RAM boot"
	depends on PMON_RAMBOOT
	default 0x80100000

config REMOTE_PCI
	bool "Support remote PCI on OPBD493X"
	depends on TOSHIBA_TC90411 && (TOSHIBA_OPBD4938 || TOSHIBA_OPBD4939)
	select PCIMEM_PHYSOFFSET if TOSHIBA_OPBD4938 || TOSHIBA_OPBD4939

config REMOTE_PCI_NATSEMI
	bool "Use DP8381x from OPBD"
	depends on REMOTE_PCI
	depends on NATSEMI
	default n

config REMOTE_PCI_8139TOO
	bool "Use 8139too from OPBD"
	depends on REMOTE_PCI
	depends on 8139TOO
	default n

config REMOTE_PCI_VIA
	bool "Use VIA Rhine from Remote"
	depends on REMOTE_PCI && VIA_RHINE
	default n

config REMOTE_PCI_USBHC
	bool "Use USBHC from Remote"
	depends on REMOTE_PCI && USB
	default y

config PCI_NOPROBE_OFFBOARD
	bool "Do not probe offboard PCI devices by default"
	depends on TOSHIBA_OPBD4938 || TOSHIBA_OPBD4939

config PICMG_PCI_BACKPLANE_DEFAULT
	bool "Support for PICMG PCI Backplane"
	depends on TX_BOARDS

config TOSHIBA_UART_TYPE
	int "UART channel type"
	range 0 2
	default "0"
	depends on TOSHIBA_TC90411 || TOSHIBA_TC90412 || TOSHIBA_TC90416

config ENABLE_INITRD_BY_LOADFROM
	bool "Enable initrd by load_from env from pmon"
	depends on TX_BOARDS
	default n
```

## drivers/mtd/bynd/Kconfig
```kconfig
#
# (C) Copyright TOSHIBA CORPORATION 2009
# All Rights Reserved.
#
# drivers/mtd/bynd/Kconfig

menu "BYND - Block laYer for Nand Driver"
	depends on MTD && BLOCK

config BYND
	tristate "BYND (Block laYer for Nand Driver) support"
	depends on MTD && BLOCK
	select MTD_BLKDEVS
	help
	  This enables read / write access to BYND flash.

config BYND_WRITE_RETRIES
	int "BYND write retries"
	depends on BYND
	default "5"

config BYND_ERASE_RETRIES
	int "BYND erase retries"
	depends on BYND
	default "5"

config BYND_MAX_LOGIC_BLK_PER_ZONE
	int "BYND max logical blocks per zone"
	depends on BYND
	default "1000"

config BYND_WRITE_CACHE
	bool "BYND write cache on"
	depends on BYND
	default "y"

endmenu
```

## kernel/Kconfig.marker
```kconfig
# Code markers configuration

config MARKERS
	bool "Activate markers"
	depends on MODULES
	help
	  Place an empty function call at each marker site. Can be
	  dynamically changed for a probe function.

config MARKERS_DISABLE_OPTIMIZATION
	bool "Disable marker optimization"
	depends on MARKERS && EMBEDDED
	default n
	help
	  Disable code replacement jump optimisations. Especially useful if your
	  code is in a read-only rom/flash.

config MARKERS_ENABLE_OPTIMIZATION
	def_bool y
	depends on MARKERS && !MARKERS_DISABLE_OPTIMIZATION
```

## ltt/Kconfig
```kconfig
config LTT
	bool "Linux Trace Toolkit Instrumentation Support"
	depends on EXPERIMENTAL
	depends on MARKERS
	select LTT_HEARTBEAT if MIPS
	select LTT_SYNTHETIC_TSC if MIPS
	default n
	help
	  It is possible for the kernel to log important events to a trace
	  facility. Doing so, enables the use of the generated traces in order
	  to reconstruct the dynamic behavior of the kernel, and hence the
	  whole system.

	  The tracing process contains 4 parts :
	      1) The logging of events by key parts of the kernel.
	      2) The tracer that keeps the events in a data buffer (uses
	         relayfs).
	      3) A trace daemon that interacts with the tracer and is
	         notified every time there is a certain quantity of data to
	         read from the tracer.
	      4) A trace event data decoder that reads the accumulated data
	         and formats it in a human-readable format.

	  If you say Y, the first component will be built into the kernel.

	  For more information on kernel tracing, the trace daemon or the event
	  decoder, please check the following address :
	       http://www.opersys.com/ltt
	  See also the experimental page of the project :
	       http://ltt.polymtl.ca

config LTT_TRACER
	tristate "Linux Trace Toolkit Tracer"
	depends on LTT
	default y
	help
	  If you enable this option, the Linux Trace Toolkit Tracer will be
	  either built in the kernel or as module.

	  Critical parts of the kernel will call upon the kernel tracing
	  function. The data is then recorded by the tracer if a trace daemon
	  is running in user-space and has issued a "start" command.

	  For more information on kernel tracing, the trace daemon or the event
	  decoder, please check the following address :
	       http://www.opersys.com/ltt
	  See also the experimental page of the project :
	       http://ltt.polymtl.ca

config LTT_RELAY
	tristate "Linux Trace Toolkit Relay+DebugFS Support"
	select RELAY
	select DEBUG_FS
	depends on LTT_TRACER
	default y
	help
	  Support using relay and debugfs to log the data obtained through LTT.

	  If you don't have special hardware, you almost certainly want
	  to say Y here.

config LTT_SERIALIZE
	tristate "Linux Trace Toolkit Serializer"
	depends on LTT_TRACER
	default y
	help
	  Library for serializing information from format string and argument
	  list to the trace buffers.

config LTT_ALIGNMENT
	bool "Align Linux Trace Toolkit Traces"
	depends on LTT
	default y
	help
	  This option enables dynamic alignment of data in buffers. The
	  alignment is made on the smallest size between architecture size
	  and the size of the value to be written.

	  Dynamically calculating the offset of the data has a performance cost,
	  but it is more efficient on some architectures (especially 64 bits) to
	  align data than to write it unaligned.

config LTT_HEARTBEAT
	bool "Activate Linux Trace Toolkit Heartbeat Timer"
	depends on LTT
	default n
	help
	  The Linux Trace Toolkit Heartbeat Timer fires at an interval small
	  enough to guarantee that the 32 bits truncated TSC won't overflow
	  between two timer execution.

config LTT_HEARTBEAT_EVENT
	bool "Write heartbeat event to shrink traces (EXPERIMENTAL)"
	depends on LTT_HEARTBEAT
	depends on EXPERIMENTAL
	default n
	help
	  This option makes the heartbeat timer write an event in each tracefile
	  at an interval that is one tenth of the time it takes to overflow 32
	  bits at your CPU frequency.

	  If this option is not enabled, 64 bits fields must be used in each
	  event header to save the full TSC : it can make traces about 1/10
	  bigger. It is suggested that you enable this option to make more
	  compact traces.

	  Note : it is currently broken with CPU hotplug and does not support
	  trace stop / restart correctly.

config LTT_SYNTHETIC_TSC
	bool "Keep a synthetic cpu timestamp counter"
	depends on LTT_HEARTBEAT
	default n
	help
	  This option is only useful on archtecture lacking a 64 bits timestamp
	  counter : it generates a "synthetic" 64 bits timestamp by updating
	  the 32 MSB at each heartbeat atomically. See kernel/ltt-heartbeat.c
	  for details.

config LTT_TEST_TSC
	bool "Test TSC synchronicity"
	depends on LTT
	default y
	depends on X86_32 || X86_64
	help
	  On i386 and x86_64, test TSC synchronicity. Fall back on a TSC|logical
	  clock scheme where CPU with TSCs lagging behind use the logical
	  relative to the highest TSC count read.

config LTT_USERSPACE_GENERIC
	bool "Allow tracing from userspace"
	depends on LTT
	default y
	help
	  This options allows processes to trace through the ltt_trace_generic
	  system call after they have registered their facilities with
	  ltt_register_generic.

config LTT_USEREVENT_TRACECONTROL
	bool "Allow trace control by userspace events (EXPERIMENTAL)"
	depends on LTT_USERSPACE_GENERIC
	default y
	help
	  This options allows setting trace control triggers by the user_generic
          event strings.
	  User specified strings given by lttctl command can trigger starting
          or stopping tracing.

config LTT_NETLINK_CONTROL
	tristate "Linux Trace Toolkit Netlink Controller"
	depends on LTT_TRACER
	select NET
	default m
	help
	  If you enable this option, the Linux Trace Toolkit Netlink Controller
	  will be either built in the kernel of as module.

config LTT_STATEDUMP
	tristate "Linux Trace Toolkit State Dump"
	depends on LTT_TRACER
	default m
	help
	  If you enable this option, the Linux Trace Toolkit State Dump will
	  be either built in the kernel of as module.

	  This module saves the state of the running kernel at trace start
	  into the trace buffers along with the ongoing tracing information.

menu "Probes"
	depends on LTT && MARKERS

config LTT_PROBE_CORE
	tristate "Linux Trace Toolkit Core Probe"
	depends on LTT_SERIALIZE
	depends on LTT_TRACER
	depends on CRC32
	default m
	help
	  Probes the core LTT events, required to have the event descriptions
	  and heartbeat events.

config LTT_PROBE_FS
	tristate "Linux Trace Toolkit File System Probe"
	depends on LTT_SERIALIZE
	depends on CRC32
	default m
	help
	  Activate per facilities LTT probes. This is the dynamic mechanism
	  where the data gathering is. Probes connect to markers when their
	  module is loaded.

	  Probe file system events. It instruments the file operations and
	  dumps the beginning of data sent through read and write system calls.

config LTT_PROBE_KERNEL
	tristate "Linux Trace Toolkit Kernel Probe"
	depends on LTT_SERIALIZE
	depends on CRC32
	default m
	help
	  LTT Kernel probe. Contains event definition for tasklet, irq,
	  soft irq, timer and scheduling events.

config LTT_PROBE_ARCH
	tristate "Linux Trace Toolkit Architecture Specific Probe"
	depends on LTT_SERIALIZE
	depends on X86_32 || ARM || MIPS || PPC || X86_64
	depends on CRC32
	default m
	help
	  LTT Arch Probe. Contains event definition specific to each
	  architecture. (system calls, traps, ...)

config LTT_PROBE_MM
	tristate "Linux Trace Toolkit Memory Probe"
	depends on LTT_SERIALIZE
	depends on CRC32
	default m
	help
	  Activate per facilities LTT probes. This is the dynamic mechanism
	  where the data gathering is. Probes connect to markers when their
	  module is loaded.

	  LTT Memory probe.

config LTT_PROBE_NET
	tristate "Linux Trace Toolkit Network Probe"
	depends on LTT_SERIALIZE
	depends on CRC32
	default m
	help
	  Activate per facilities LTT probes. This is the dynamic mechanism
	  where the data gathering is. Probes connect to markers when their
	  module is loaded.

	  LTT Network probe.

config LTT_PROBE_LIST
	tristate "Linux Trace Toolkit system listing probe"
	depends on LTT_SERIALIZE
	depends on LTT_STATEDUMP
	depends on CRC32
	default m
	help
	  System listing probe. Contains events for dumping kernel
	  state at the beginning of a trace.

config LTT_PROBE_LOCKING
	tristate "Linux Trace Toolkit locking"
	depends on LTT_SERIALIZE
	depends on X86_32 || MIPS || S390 || SUPERH || SPARC64 || UML || X86_64
	depends on CRC32
	select TRACE_IRQFLAGS
	select DEBUG_KERNEL
	select TRACE_IRQFLAGS_SUPPORT
	select STACKTRACE_SUPPORT
	select LOCKDEP_SUPPORT
	select LOCKDEP
	select DEBUG_LOCK_ALLOC
	default m
	help
	  LTT locking probe. Traces currently only interrupt save/restore and
	  disable/enable. Currently only for i386, MIPS, S390, SH, Sparc64, UML
	  and x86_64. Will trace events from lockdep when connected with a
	  probe.

config LTT_PROBE_STACK
	tristate "Sample process or kernel stacks (EXPERIMENTAL)"
	depends on LTT_SERIALIZE
	depends on X86 || X86_64
	depends on CRC32
	default n
	help
	  Get complete process and/or kernel stack (architecture specific)

config LTT_PROCESS_STACK
	bool "Get complete process stack"
	depends on LTT_PROBE_STACK
	depends on X86
	depends on CRC32
	default n
	help
	  Get complete process stack.

	  It has three limitations : it only considers functions in the loaded
	  executable (not libraries) to be actual function pointers.
	  Furthermore, it will dump the stack of many threads at once for
	  multithreaded processes (it is protected from races between threads
	  though). It can also believe that arbritrary data on the stack
	  "looks like" a function pointer.

config LTT_PROCESS_MAX_FUNCTION_STACK
	int "Maximum number of longs on the stack between functions"
	depends on LTT_PROCESS_STACK
	default 100
	help
	  Maximum threshold over which, if we do not find a function pointer on
	  the process stack, we stop dumping the pointers on the stack.

config LTT_PROCESS_MAX_STACK_LEN
	int "Maximum number of longs on the stack to read"
	depends on LTT_PROCESS_STACK
	default 250
	help
	  Maximum threshold of stack size over which we stop looking for
	  function pointers.

config LTT_KERNEL_STACK
	bool "Get complete kernel stack"
	depends on LTT_PROBE_STACK
	default n
	help
	  Get complete kernel stack

config LTT_PROBE_COMPACT
	tristate "Linux Trace Toolkit Compact Probe"
	depends on LTT_SERIALIZE
	depends on LTT_HEARTBEAT_EVENT
	depends on CRC32
	default n
	help
	  Compact facility : 32 bits compact TSC and event ID. One single
	  "compact" or "flight-compact" channel for all those events.

endmenu
```

## tsb_modules/Kconfig
```kconfig
#
# Toshiba Module Configuration
#

menu "Toshiba Module"

source "tsb_modules/char/Kconfig"

endmenu
```
